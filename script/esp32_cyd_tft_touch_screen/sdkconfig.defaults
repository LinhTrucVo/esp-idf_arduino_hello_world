## script/esp32_cyd_tft_touch_screen/sdkconfig.defaults
```kconfig
CONFIG_FREERTOS_HZ=1000
CONFIG_AUTOSTART_ARDUINO=y
CONFIG_ESPTOOLPY_FLASHSIZE_4MB=y
CONFIG_ESPTOOLPY_FLASHSIZE="4MB"

CONFIG_TFT_ILI9341_2_DRIVER=y
CONFIG_TFT_HSPI_PORT=y
CONFIG_TFT_MISO=-1
CONFIG_TFT_MOSI=13
CONFIG_TFT_SCLK=14
CONFIG_TFT_CS=15
CONFIG_TFT_DC=2
CONFIG_TFT_RST=12
CONFIG_TFT_BL=21
```
